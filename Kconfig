## Kconfig
```kconfig
#
# Copyright 2015, Wink Saville
#
# This software may be distributed and modified according to the terms of
# the BSD 2-Clause license. Note that NO WARRANTY is provided.
# See "LICENSE_BSD2.txt" for details.
#
# @TAG(NICTA_BSD)
#

config LIB_SEL4_THRDS
    bool "Thrds for seL4"
    default y
    depends on LIB_SEL4 && HAVE_LIBC && LIB_SEL4_VKA && LIB_SEL4_UTILS && \
               LIB_SEL4_VSPACE && LIB_SEL4_SIMPLE && LIB_UTILS && LIB_SEL4_PLAT_SUPPORT
    help
        Thrds is a thread/process manager library for seL4
```
